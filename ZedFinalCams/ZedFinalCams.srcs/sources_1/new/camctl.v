`timescale 1ns / 1ps
//////////////////////////////////////////////////////////////////////////////////
// Module for reading from the AL422b FIFO and storing pixel line data in a 
// local buffer.
//////////////////////////////////////////////////////////////////////////////////
module imgbuf2(
    input output_sel,
    input get_data, // trigger a new image capture
	input [10:0] href, // from microblaze, 0-751
	input [10:0] vref,
	input blank,
	input [7:0] fifo_data, // 8 bit data in from fifo
	input fifo_rck, // 1MHz clock signal generated by FPGA
	input vga_clk,
    output reg image_sel,
	output reg fifo_rrst, // fifo read reset (reset read addr pointer to 0)
	output reg fifo_oe, // fifo output enable (allow for addr pointer to increment)
	output reg [7:0] pixel_value, // 8-bit value from internal buffer
	output reg trigger,
	output reg buffer_ready
   );

//reg image_sel = 1'b0; 
reg wen_l, wen_r; 

parameter [1:0] ready = 2'b00;
parameter [1:0] read = 2'b01;
parameter [1:0] done = 2'b10;  
parameter [1:0] init = 2'b11;

reg [1:0] state = ready;
reg [1:0] prev_state, next_state = ready;

reg [9:0] pixel = 10'b00_0000_0000;
reg [15:0] num_lines = 16'h0000;

reg [18:0] addra;
always @(num_lines,pixel)
    if(128<=pixel && pixel <= 512 && num_lines >= 96 && num_lines <= 384)
        addra = (384*(num_lines-96))+(pixel-128);
    else
        addra = 19'd0;

reg [18:0] addrb;
always @(vref,href)
    if(128<=href && href <= 512 && vref >= 96 && vref <= 384)
        addrb = (384*(vref-96))+(href-128);
    else
        addrb = 19'd0;
        
wire [7:0] left_dout;
blk_mem_640_480 left(
    .clka(fifo_rck),
    .wea(wen_l),
    .addra(addra), // 19 bits
    .dina(fifo_data), // 8 bits
    .clkb(vga_clk), 
    .enb(1'b1),
    .addrb(addrb), // 19 bits
    .doutb(left_dout) // 8 bits
);

wire [7:0] right_dout;
blk_mem_640_480 right(
    .clka(fifo_rck),
    .wea(wen_r),
    .addra(addra), // 19 bits
    .dina(fifo_data), // 8 bits
    .clkb(vga_clk), 
    .enb(1'b1),
    .addrb(addrb), // 19 bits
    .doutb(right_dout) // 8 bits
);

always @(posedge fifo_rck)
	state <= next_state;
	
always @(state,get_data,num_lines,pixel)	
	case(state)
		ready: 
			begin
				if(get_data) 
					next_state = init;
				else
					next_state = ready;
					
				prev_state = ready;
			end
		init: 
			begin
				next_state = read;
				prev_state = init;
			end
		read: 
			begin
				if(num_lines == 479 && image_sel == 1'b1)
					next_state = done;
				else
					next_state = read;
					
				prev_state = read;
			end
		done: 
			begin
			    next_state = ready;
				prev_state = done;
			end
	endcase

always @(posedge fifo_rck)
begin
    case(state)
        // allow for VGA controller to read from pixel_line
		ready:
		    begin 
		    wen_l <= 1'b0;
		    wen_r <= 1'b0;
		    pixel <= 10'b00_0000_000;
            num_lines <= 16'h0000;
			if(next_state == init)
			   trigger <= 1'b1;
			end
	   // prepare to read new data from the AL422 into local memory
		init: 
			begin
			fifo_rrst <= 1'b0; // allow for read addr to increment
			trigger <= 1'b0;
			pixel <= 10'b00_0000_000;
		    num_lines <= 16'h0000;
			buffer_ready <= 1'b0;
			fifo_oe <= 1'b0; // reset read pointer for next run
			image_sel <= 1'b0;
		end
		// read data in from the AL422 into local memory
		read: 
			begin
		    trigger <= 1'b0;
		    fifo_rrst <= 1'b1; // allow read pointer to increment
		    // truncate 752x480 image to CIF (384x288)
		    if(128<=pixel && pixel <= 512 && num_lines >= 96 && num_lines <= 384) begin
		      if(image_sel == 1'b0) begin
		          wen_l <= 1'b1;
		          wen_r <= 1'b0;
		          end
		      else begin
		          wen_l <= 1'b0;
                  wen_r <= 1'b1;
		          end
		      end
		    else begin
		      wen_l <= 1'b0;
              wen_r <= 1'b0;
		      end
		    
		    // turn off read enable if at end of read sequence
			if(next_state == done)
				fifo_oe <= 1'b1; 
			// cycle through pixel count
//			if(prev_state == init)begin
//			    pixel <= 0;
//			    num_lines <= 0;
//			    end
			else if(pixel < 751) 
				pixel <= pixel + 1'b1;
			else if(num_lines < 479)
				begin
				pixel <= 10'b00_0000_0000;
				num_lines <= num_lines + 1'b1;
				end
			// cycle from left -> right image
		    else if(num_lines == 479 && image_sel == 1'b0)
		       begin
		       fifo_rrst <= 1'b0; // reset read pointer
		       image_sel <= 1'b1;
		       pixel <= 10'b00_0000_0000;
		       num_lines <= 16'd0;
		       end
            end
     
		// close out read sequence before returning to ready state
		done:
			begin
			fifo_rrst <= 1'b0; // reset read addr to 0
			trigger <= 1'b0;
			buffer_ready <= 1'b1;
			end
		endcase
end 

// allow for VGA controller to read stored pixel line at given addr if state==ready
always @ (buffer_ready, href, vref, blank, pixel_value,output_sel)
    // clear output when VGA is blanking
	if(blank)
		pixel_value [7:0] = 8'h00;
	else if(128<=href && href <= 512 && vref >= 96 && vref <= 384)
        if(~output_sel)
            pixel_value = left_dout;
        else
            pixel_value = right_dout;
    else
        pixel_value <= 8'h00;
		
		
endmodule
